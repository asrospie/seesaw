## drivers/seesaw/Kconfig
```kconfig
# Create a new option in menuconfig
config ADAFRUIT_SEESAW
    bool "Adafruit Seesaw"
    default n
    depends on I2C
    help
        Enable the adafruit seesaw driver
```

## dts/bindings/i2c/adafruit,seesaw.yaml
```yaml
# Description of the device
description: Adafruit Seesaw

compatible: "adafruit,seesaw"

include: i2c-device.yaml

# Define the required node properties
```
